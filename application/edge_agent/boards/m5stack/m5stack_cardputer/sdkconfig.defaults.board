## application/edge_agent/boards/m5stack/m5stack_cardputer/sdkconfig.defaults.board
```kconfig
# M5Stack Cardputer — ESP32-S3FN8 (8 MB QIO flash, NO PSRAM)
CONFIG_ESP_DEFAULT_CPU_FREQ_MHZ_240=y

CONFIG_ESPTOOLPY_FLASHMODE_QIO=y
CONFIG_ESPTOOLPY_FLASHFREQ_80M=y
CONFIG_ESPTOOLPY_FLASHSIZE_8MB=y

CONFIG_PARTITION_TABLE_CUSTOM=y
CONFIG_PARTITION_TABLE_CUSTOM_FILENAME="partitions_8MB.csv"

# No PSRAM on Cardputer — force-disable everything that requires it.
CONFIG_SPIRAM=n
CONFIG_SPIRAM_TRY_ALLOCATE_WIFI_LWIP=n
CONFIG_SPIRAM_ALLOW_BSS_SEG_EXTERNAL_MEMORY=n
CONFIG_SPIRAM_ALLOW_NOINIT_SEG_EXTERNAL_MEMORY=n
CONFIG_FREERTOS_TASK_CREATE_ALLOW_EXT_MEM=n
CONFIG_SPIRAM_XIP_FROM_PSRAM=n
CONFIG_MBEDTLS_EXTERNAL_MEM_ALLOC=n

# USB: native Serial/JTAG for console
CONFIG_ESP_CONSOLE_USB_SERIAL_JTAG=y
CONFIG_ESP_CONSOLE_SECONDARY_NONE=y
```
